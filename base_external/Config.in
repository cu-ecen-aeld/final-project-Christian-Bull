## base_external/Config.in
```kconfig
menu "Project Base Customizations"
    source "$BR2_EXTERNAL_project_base_PATH/package/soil-moisture-sensor/Config.in"
endmenu
```

## base_external/package/soil-moisture-driver/Config.in
```kconfig
config BR2_PACKAGE_SOIL_MOISTURE_DRIVER
	bool "soil-moisture-driver"
	help
	  Custom driver to support soil moisture sensors
```

## base_external/package/soil-moisture-sensor/Config.in
```kconfig
config BR2_PACKAGE_SOIL_MOISTURE_SENSOR
	bool "soil-moisture-sensor"
	help
	  Custom package to hold the sensor-scraper and associated webserver
```
