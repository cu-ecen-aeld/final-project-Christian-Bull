/dts-v1/;
/plugin/;

/ {
    compatible = "brcm,bcm2711", "brcm,bcm2835";

    fragment@0 {
        target = <&i2c1>;
        __overlay__ {
            status = "okay";

            soil_adc: ads1115@48 {
                compatible = "christian,soil-sensor";
                reg = <0x48>;
            };
        };
    };
};
